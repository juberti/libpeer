## examples/esp32/main/Kconfig.projbuild
```kconfig
menu "ESP32 Hardware Configuration"

    choice ESP32_CAMERA_MODEL
        prompt "Camera model"
        default ESP32_EYE
        help
            Select the camera model to use.
        config ESP32_EYE
            bool "ESP32-EYE"
        config ESP32S3_EYE
            bool "ESP32S3-EYE"
        config ESP32_M5STACK_CAMERA_B
            bool "M5STACK-CAMERA-B"
        config ESP32S3_XIAO_SENSE
            bool "ESP32S3-XIAO-SENSE"
    endchoice

endmenu

menu "Signaling Configuration"

    config WHIP_URL
        string "WHIP URL"
        default ""
        help
            URL for WHIP Endpoint.

    config WHIP_PORT
        int "WHIP PORT"
        default 443
        help
            Port for WHIP Endpoint.

    config WHIP_BEARER_TOKEN
        string "WHIP Bearer Token"
        default ""
        help
            Bearer token used in HTTP Authorization header.

endmenu
```
